#include <Arduino.h>
#include <Wire.h>
#include <Adafruit_GFX.h>
#include <Adafruit_SSD1306.h>
#include "DHT.h"

#define P1 35
#define P2 32
#define P3 33   // ปุ่มกดต่อที่ GPIO13
#define DHTPIN 4    
#define DHTTYPE DHT22   // DHT 22  (AM2302), AM2321
#define SCREEN_WIDTH 128 
#define SCREEN_HEIGHT 64 
int stP1 = 0;  // ตัวแปรเก็บสถานะปุ่ม
int UndoPIN = 0;
int confirmB = 0;
int Sconfirm = 0;
int stP3 = 0;
int i = 0;
float h ;
float t ;
float f ;

DHT dht(DHTPIN, DHTTYPE);

Adafruit_SSD1306 display(SCREEN_WIDTH, SCREEN_HEIGHT, &Wire, -1);

// 'page3', 128x64px
const unsigned char epd_bitmap_page3 [] PROGMEM = {
	0x00, 0x00, 0x00, 0x00, 0x00, 0x00, 0x00, 0x00, 0x00, 0x00, 0x00, 0x00, 0x00, 0x00, 0x00, 0x00, 
	0x00, 0x00, 0x00, 0x00, 0x00, 0x00, 0x00, 0x00, 0x00, 0x00, 0x00, 0x00, 0x00, 0x00, 0x00, 0x00, 
	0x00, 0x00, 0x00, 0x00, 0x00, 0x00, 0x00, 0x00, 0x00, 0x00, 0x00, 0x00, 0x00, 0x00, 0x00, 0x00, 
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	0x7f, 0xff, 0xff, 0xff, 0xff, 0xff, 0xff, 0xff, 0xff, 0xff, 0xff, 0xff, 0xff, 0xff, 0xff, 0xf8
};
// 'page2', 128x64px
const unsigned char epd_bitmap_page2 [] PROGMEM = {
	0x00, 0x00, 0x00, 0x00, 0x00, 0x00, 0x00, 0x00, 0x00, 0x00, 0x00, 0x00, 0x00, 0x00, 0x00, 0x00, 
	0x00, 0x00, 0x00, 0x00, 0x00, 0x00, 0x00, 0x00, 0x00, 0x00, 0x00, 0x00, 0x00, 0x00, 0x00, 0x00, 
	0x00, 0x00, 0x00, 0x00, 0x00, 0x00, 0x00, 0x00, 0x00, 0x00, 0x00, 0x00, 0x00, 0x00, 0x00, 0x00, 
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	0x00, 0x00, 0x00, 0x00, 0x00, 0x00, 0x00, 0x00, 0x00, 0x00, 0x00, 0x00, 0x00, 0x00, 0x00, 0x00
};
// 'page1', 128x64px
const unsigned char epd_bitmap_page1 [] PROGMEM = {
	0x3f, 0xff, 0xff, 0xff, 0xff, 0xff, 0xff, 0xff, 0xff, 0xff, 0xff, 0xff, 0xff, 0xff, 0xff, 0xfc, 
	0x40, 0x00, 0x00, 0x00, 0x00, 0x00, 0x00, 0x00, 0x00, 0x00, 0x00, 0x00, 0x00, 0x00, 0x00, 0x02, 
	0x80, 0x00, 0x00, 0x00, 0x00, 0x00, 0x00, 0x00, 0x00, 0x00, 0x00, 0x00, 0x00, 0x00, 0x00, 0x01, 
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	0x00, 0x00, 0x00, 0x00, 0x00, 0x00, 0x00, 0x00, 0x00, 0x00, 0x00, 0x00, 0x00, 0x00, 0x00, 0x00
};

// Array of all bitmaps for convenience. (Total bytes used to store images in PROGMEM = 3120)
const int epd_bitmap_allArray_LEN = 3;
const unsigned char* epd_bitmap_allArray[3] = {
	epd_bitmap_page1,
	epd_bitmap_page2,
	epd_bitmap_page3
};

void setup() {
  pinMode(P1, INPUT);
  pinMode(P2, INPUT);
  pinMode(P3, INPUT);
  if(!display.begin(SSD1306_SWITCHCAPVCC, 0x3C)) { 
    Serial.println(F("SSD1306 allocation failed")); 
    for(;;); 
  }
  Serial.println(F("DHTxx test!"));

  dht.begin(); 
  delay(2000); // Pause for 2 seconds
  if (isnan(h) || isnan(t) || isnan(f)) {
	Serial.println(F("Failed to read from DHT sensor!"));
	return;
  }	
  display.clearDisplay();
  Serial.begin(115200);
}

void loop() {
  stP1 = digitalRead(P1);
  confirmB = digitalRead(P2);
  stP3 = digitalRead(P3);

  display.drawBitmap(0, 0, epd_bitmap_allArray[i], 128, 64, 1); 
  display.display();

  if(stP1 == HIGH) {
    i++;
  }
  if(stP3 == HIGH) {
    i--;
  }
  display.clearDisplay();

  if(i >= epd_bitmap_allArray_LEN) // max 2
  	i = 0;
  if(i <= 0) // minimum 0
  	i = 0;

  if(confirmB == HIGH) {
	Sconfirm = 1 ;
	display.clearDisplay();
  }

  while (Sconfirm == 1)
  {
	UndoPIN = digitalRead(P3); // Read button state inside the loop
	display.clearDisplay();
	if(UndoPIN == HIGH){
		Sconfirm = 0;
	}
	if(i == 0)
	{
		display.setTextSize(2);
		display.setTextColor(SSD1306_WHITE); 
		display.setCursor(0,0); 
		display.println("page1!!!!!!!!");
		display.display(); 
	}
	if(i == 1)
	{
		h = dht.readHumidity();
		t = dht.readTemperature();
		f = dht.readTemperature(true);
		display.setTextSize(1);      
		display.setTextColor(SSD1306_WHITE); 
		display.setCursor(0,0);     
		display.println("DHTxx test!");
		display.print("Humidity: "); 
		display.print(h);
		display.println(" %");
		display.print("Temperature: "); 
		display.print(t);
		display.println(" *C ");
		display.print("Temperature: "); 
		display.print(f);
		display.println(" *F");
		display.display(); 
	}
	if(i == 2){
		display.setTextSize(2);
		display.setTextColor(SSD1306_WHITE); 
		display.setCursor(0,0); 
		display.println("page2!!!!!!!!");
		display.display(); 		
	}
	//Sconfirm = 0;
  }
}
